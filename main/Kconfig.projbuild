## main/Kconfig.projbuild
```kconfig
menu "ThingSpeak ESP DHT11 Configuration"
        
config THINGSPEAK_API_WRITE_KEY
    string "ThingSpeak channel's API write key"
    default "NOTSET"
    help
        The API Write key for your ThingSpeak channel

config DHT11_DATA_PIN
    int "DHT11 data pin"
    default 4
    help
        The pin on where the DHT11 data line is connected (eg 4)

config WIFI_SSID
    string "WiFi SSID"
    default "myssid"
    help
        SSID (network name) for the example to connect to.

config WIFI_PASSWORD
    string "WiFi Password"
    default "mypassword"
    help
        WiFi password (WPA or WPA2) for the example to use.

endmenu
```
